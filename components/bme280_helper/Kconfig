## components/bme280_helper/Kconfig
```kconfig
menu "BME280 Helper"
    config SDA_PIN
        int "SDA pin"
        default 21
        help
            GPIO pin to use for SDA of I2C
    config SCL_PIN
        int "SCL pin"
        default 22
        help
            GPIO pin to use for SCL of I2C
    config READ_INTERVAL_SECONDS
        int "Seconds between sensor reads"
        default 10
        help
            Number of seconds to wait between sensor reads
endmenu
```

## components/chicken_incubator/Kconfig
```kconfig
menu "Chicken Incubator"
    config ROTATIONS_PER_DAY
        int "Rotations per day"
        default 5
        help
            Number of times per day to rotate
endmenu
```

## components/heater/Kconfig
```kconfig
menu "Heater"
    config HEATER_GPIO_NUMBER
        int "GPIO pin number"
        default 12
        help
            The pin used to control the heater relay
endmenu
```

## components/humidifier/Kconfig
```kconfig
menu "Humidifier"
    config HUMIDIFIER_GPIO_NUMBER
        int "GPIO pin number"
        default 27
        help
            The pin used to control the humidifier relay
endmenu
```

## components/mqtt_helper/Kconfig
```kconfig
menu "MQTT Helper"
    config MQTT_BROKER_URL
        string "MQTT Broker URL"
        default "mqtt://iot.eclipse.org"
        help
            URL of the MQTT broker to connect to
endmenu
```

## components/sntp_helper/Kconfig
```kconfig
menu "SNTP Helper"
    config SNTP_HOST
        string "SNTP HOST"
        default "pool.ntp.org"
        help
            URL of the SNTP server to connect to

    config NTP_SYNC_PERIOD_SECONDS
        int "NTP Sync period"
        default 86400
        help
            How frequently time should be sync'd with NTP server, in seconds
endmenu
```

## components/uln2003_stepper_driver/Kconfig
```kconfig
menu "Stepper driver"
    config IN1_PIN
        int "IN1 Pin"
        default 5
        help
            The pin to use for stepper driver input 1

    config IN2_PIN
        int "IN1 Pin"
        default 6
        help
            The pin to use for stepper driver input 2

    config IN3_PIN
        int "IN1 Pin"
        default 7
        help
            The pin to use for stepper driver input 3

    config IN4_PIN
        int "IN4 Pin"
        default 8
        help
            The pin to use for stepper driver input 4
endmenu
```

## components/wifi_helper/Kconfig
```kconfig
menu "Wi-Fi Helper"
    config WIFI_SSID
        string "WiFi SSID"
        default "myssid"
        help
            SSID (network name) for the example to connect to.

    config WIFI_PASSWORD
        string "WiFi Password"
        default "mypassword"
        help
            WiFi password (WPA or WPA2) for the example to use.

    config WIFI_MAXIMUM_RETRY
        int "Maximum retry"
        default 5
        help
            Set the maximum number of retries to avoid station trying to reconnect to the AP forever when the AP is really inexistent.
endmenu
```
